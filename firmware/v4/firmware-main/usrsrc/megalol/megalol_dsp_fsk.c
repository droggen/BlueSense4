#include <stdio.h>
#include <malloc.h>
#include <string.h>
#include "stm32l496xx.h"
#include "megalol_dsp.h"
#include "megalol_dsp_r2iq.h"
#include "stmcic.h"
#include "global.h"
#include "dfsdm.h"
#include "megalol_comm_softuart.h"
#include "main.h"
#include "helper.h"
#include "ufat.h"
#include "wait.h"
#include "stmdac.h"
#include "megalol_dsp_fsk.h"
#include "stmadcfast.h"
#include "serial_usart3.h"
#include "stm32l4xx_hal.h"


#define DSP_FSK_USE_CIC_16BIT	1

// Allocate both 32-bit or 16-bit CIC result as tests/benchmarks use both
int _fsk_di[CICBUFSIZ/2+1],_fsk_dq[CICBUFSIZ/2+1];			// +1 to hold the previous sample value to ensure streaming implementation of crossproduct
short _fsk_dis[CICBUFSIZ/2+2],_fsk_dqs[CICBUFSIZ/2+2];		// +2: +1 to hold the previous sample value to ensure streaming implementation of crossproduct, and +1 for SIMD implementation reading 32-bit at a time.
short _fsk_tmp_di[CICBUFSIZ],_fsk_tmp_dq[CICBUFSIZ];		// Test variables: write two I, Q lanes prior to CIC filtering. Lanes have 0 I 0 -I ..., Q 0 -Q 0...
int _fsk_cp[CICBUFSIZ/2];									// Result of cross-product
int _fsk_cp2[CICBUFSIZ/2];
int _fsk_cp3[CICBUFSIZ/2];
unsigned char _fsk_binary[CICBUFSIZ/2+4];						// Binary outcome of demodulation, and input to decoding. Extra space for SIMD processing.
unsigned char _fsk_binary2[CICBUFSIZ/2+4];						// Binary outcome of demodulation, and input to decoding
unsigned char _fsk_binary3[CICBUFSIZ/2+4];						// Binary outcome of demodulation, and input to decoding
int _fsk_downsampling=2;

// Spectrum generated from Matlab with an asymetrial shape
short testsignal_recognizablespectrum[FSKTESTSIGNALLEN]={4095,1704,1378,2239,1989,1899,2250,1764,2233,1845,1866,1945,1792,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1984,1884};
// Recorded under sampled signal with real transmitted data. Sample rate: 1198080
short testsignal_realundersampled_0[FSKTESTSIGNALLEN]={2867,87,2446,3870,589,1085,4018,1813,273,3382,2996,93,2289,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2593,3699};

/*
	Generate a signal with 0,1 and benchmark demodulation of frames.
*/
void fsk_demod_test_1()
{
	// Simulate undersampled data
	int sr = 1198080;
	int fc = 299520;
	int br=115200;
	int f0 = fc-br/2;
	int f1 = fc+br/2;

	//unsigned short data[CICBUFSIZ*4];
	signed short data[CICBUFSIZ];
	unsigned datalen=sizeof(data)/sizeof(unsigned short);

	fprintf(file_pri,"Test data lenghth: %d\n",datalen);
	fprintf(file_pri,"Float: %f\n",3.141592);

	fsk_gentestsignal(data,datalen,sr,f0,f1,br);

	fprintf(file_pri,"Data: "); print_array_short(file_pri,data,datalen);

	fsk_demod_bench(data,datalen);
}
/*
	Generate a signal with well known artificial spectrum, and print I, Q and CP after each frame.
*/
void fsk_demod_test_2()
{
	// Generate well recognised spectrum.
	// Simulate undersampled data
	//int sr = 1198080;
	//int fc = 299520;
	//int br=115200;
	//int f0 = fc-br/2;
	//int f1 = fc+br/2;


	signed short data[FSKTESTSIGNALLEN];			// Same length as matlab
	unsigned datalen=sizeof(data)/sizeof(unsigned short);


	fprintf(file_pri,"Test data lenghth: %d\n",datalen);
	fprintf(file_pri,"Float: %f\n",3.141592);
	// Clear target
	for(int i=0;i<datalen;i++)
		data[i] = 0;

	//fsk_gentestsignal2(data,datalen,sr,fc,bfs,bff);
	fsk_gentestsignal2b(data);

	fprintf(file_pri,"Data: "); print_array_short(file_pri,data,datalen);

	// Step-by-step demodulation.
	// Number of frames
	int nf = FSKTESTSIGNALLEN/CICBUFSIZ;

	unsigned log=0;
	FILE *file = ufat_log_open(log);
	if(!file)
	{
		fprintf(file_pri,"Error opening log %d\n",log);
		return;
	}

	fsk_demod_init();
	for(int fi=0;fi<nf;fi++)
	//for(int fi=0;fi<1;fi++)
	{
		fprintf(file_pri,"Processing frame %d out of %d\n",fi,nf);
		fprintf(file_pri,"Data: "); print_array_short(file_pri,&data[fi*CICBUFSIZ],CICBUFSIZ);
		// Initialise the internal buffers for easy debugging
		for(unsigned i=0;i<CICBUFSIZ/2;i++)
		{
			_fsk_di[i+1]=_fsk_dq[i+1]=0xfffff;		// +1 as di,dq has +1 size
			_fsk_cp[i]=0xfffff;
		}
		//CICBUFSIZ

		fsk_demod_frame(&data[fi*CICBUFSIZ],_fsk_binary,1);

		fprintf(file_pri,"I:\n"); for(unsigned i=0;i<CICBUFSIZ/2;i++) fprintf(file_pri,"%d ",_fsk_di[i+1]>>8); fprintf(file_pri,"\n");
		fprintf(file_pri,"Q:\n"); for(unsigned i=0;i<CICBUFSIZ/2;i++) fprintf(file_pri,"%d ",_fsk_dq[i+1]>>8); fprintf(file_pri,"\n");
		//fprintf(file_pri,"CP:\n"); for(unsigned i=0;i<CICBUFSIZ/2;i++) fprintf(file_pri,"%d ",_fsk_cp[i]); fprintf(file_pri,"\n");
		fprintf(file_pri,"CPsign:\n"); for(unsigned i=0;i<CICBUFSIZ/2;i++) fprintf(file_pri,"%d ",_fsk_binary[i]); fprintf(file_pri,"\n");

		fprintf(file,"I:\n"); for(unsigned i=0;i<CICBUFSIZ/2;i++) fprintf(file,"%d ",_fsk_di[i+1]>>8); fprintf(file,"\n");
		fprintf(file,"Q:\n"); for(unsigned i=0;i<CICBUFSIZ/2;i++) fprintf(file,"%d ",_fsk_dq[i+1]>>8); fprintf(file,"\n");
		//fprintf(file,"CP:\n"); for(unsigned i=0;i<CICBUFSIZ/2;i++) fprintf(file,"%d ",_fsk_cp[i]); fprintf(file,"\n");
		fprintf(file,"CPsign:\n"); for(unsigned i=0;i<CICBUFSIZ/2;i++) fprintf(file,"%d ",_fsk_binary[i]); fprintf(file,"\n");


	}
	ufat_log_close();

}


/*
	Generate a signal with 1,0, and print I, Q and CP after each frame.
*/
void fsk_demod_test_3()
{
	// Simulate undersampled data
	int sr = 1198080;
	int fc = 299520;
	int br=115200;
	int f0 = fc-br/2;
	int f1 = fc+br/2;

	signed short data[CICBUFSIZ*3];
	//unsigned short data[CICBUFSIZ];
	unsigned datalen=sizeof(data)/sizeof(unsigned short);

	fprintf(file_pri,"Test data lenghth: %d\n",datalen);
	fprintf(file_pri,"Float: %f\n",3.141592);

	fsk_gentestsignal(data,datalen,sr,f0,f1,br);

	fprintf(file_pri,"Data: "); print_array_short(file_pri,data,datalen);


	// Step-by-step demodulation.
	// Number of frames
	int nf = FSKTESTSIGNALLEN/CICBUFSIZ;

	/*unsigned log=0;
	FILE *file = ufat_log_open(log);
	if(!file)
	{
		fprintf(file_pri,"Error opening log %d\n",log);
		return 1;
	}*/

	fsk_demod_init();
	for(int fi=0;fi<nf;fi++)
	//for(int fi=0;fi<1;fi++)
	{
		fprintf(file_pri,"Processing frame %d out of %d\n",fi,nf);
		fprintf(file_pri,"Data: "); print_array_short(file_pri,&data[fi*CICBUFSIZ],CICBUFSIZ);
		// Initialise the internal buffers for easy debugging
		for(unsigned i=0;i<CICBUFSIZ/2;i++)
		{
			_fsk_di[i+1]=_fsk_dq[i+1]=0xfffff;		// +1 as di,dq has +1 size
			_fsk_cp[i]=0xfffff;
		}
		//CICBUFSIZ

		fsk_demod_frame(&data[fi*CICBUFSIZ],_fsk_binary,1);

		fprintf(file_pri,"I:\n"); for(unsigned i=0;i<CICBUFSIZ/2;i++) fprintf(file_pri,"%d ",_fsk_di[i+1]>>8); fprintf(file_pri,"\n");
		fprintf(file_pri,"Q:\n"); for(unsigned i=0;i<CICBUFSIZ/2;i++) fprintf(file_pri,"%d ",_fsk_dq[i+1]>>8); fprintf(file_pri,"\n");
		//fprintf(file_pri,"CP:\n"); for(unsigned i=0;i<CICBUFSIZ/2;i++) fprintf(file_pri,"%d ",_fsk_cp[i]); fprintf(file_pri,"\n");
		fprintf(file_pri,"CPsign:\n"); for(unsigned i=0;i<CICBUFSIZ/2;i++) fprintf(file_pri,"%d ",_fsk_binary[i]); fprintf(file_pri,"\n");

		/*fprintf(file,"I:\n"); for(unsigned i=0;i<CICBUFSIZ/2;i++) fprintf(file,"%d ",_fsk_di[i+1]>>8); fprintf(file,"\n");
		fprintf(file,"Q:\n"); for(unsigned i=0;i<CICBUFSIZ/2;i++) fprintf(file,"%d ",_fsk_dq[i+1]>>8); fprintf(file,"\n");
		fprintf(file,"CP:\n"); for(unsigned i=0;i<CICBUFSIZ/2;i++) fprintf(file,"%d ",_fsk_cp[i]); fprintf(file,"\n");*/


	}
	//ufat_log_close();

}
/*
 Real data demodulation
*/
void fsk_demod_test_4()		// Real undersampled recording
{

	//int sr = 1198080;
	//int fc = 299520;
	//int br=115200;
	//int f0 = fc-br/2;
	//int f1 = fc+br/2;


	signed short data[FSKTESTSIGNALLEN];			// Same length as matlab
	unsigned datalen=sizeof(data)/sizeof(unsigned short);


	fprintf(file_pri,"Test data lenghth: %d\n",datalen);
	fprintf(file_pri,"Float: %f\n",3.141592);
	// Clear target
	for(int i=0;i<datalen;i++)
		data[i] = 0;


	fsk_gentestsignal3(data);

	fprintf(file_pri,"Data: "); print_array_short(file_pri,data,datalen);

	// Step-by-step demodulation.
	// Number of frames
	int nf = FSKTESTSIGNALLEN/CICBUFSIZ;

	/*unsigned log=0;
	FILE *file = ufat_log_open(log);
	if(!file)
	{
		fprintf(file_pri,"Error opening log %d\n",log);
		return 1;
	}*/

	fsk_demod_init();
	for(int fi=0;fi<nf;fi++)
	//for(int fi=0;fi<1;fi++)
	{
		fprintf(file_pri,"Processing frame %d out of %d\n",fi,nf);
		fprintf(file_pri,"Data: "); print_array_short(file_pri,&data[fi*CICBUFSIZ],CICBUFSIZ);
		// Initialise the internal buffers for easy debugging
		for(unsigned i=0;i<CICBUFSIZ/2;i++)
		{
			_fsk_di[i+1]=_fsk_dq[i+1]=0xfffff;		// +1 as di,dq has +1 size
			_fsk_cp[i]=0xfffff;
		}
		//CICBUFSIZ

		fsk_demod_frame(&data[fi*CICBUFSIZ],_fsk_binary,1);

		fprintf(file_pri,"I:\n"); for(unsigned i=0;i<CICBUFSIZ/2;i++) fprintf(file_pri,"%d ",_fsk_di[i+1]>>8); fprintf(file_pri,"\n");
		fprintf(file_pri,"Q:\n"); for(unsigned i=0;i<CICBUFSIZ/2;i++) fprintf(file_pri,"%d ",_fsk_dq[i+1]>>8); fprintf(file_pri,"\n");
		//fprintf(file_pri,"CP:\n"); for(unsigned i=0;i<CICBUFSIZ/2;i++) fprintf(file_pri,"%d ",_fsk_cp[i]); fprintf(file_pri,"\n");
		fprintf(file_pri,"CPsign:\n"); for(unsigned i=0;i<CICBUFSIZ/2;i++) fprintf(file_pri,"%d ",_fsk_binary[i]); fprintf(file_pri,"\n");

		/*fprintf(file,"I:\n"); for(unsigned i=0;i<CICBUFSIZ/2;i++) fprintf(file,"%d ",_fsk_di[i+1]>>8); fprintf(file,"\n");
		fprintf(file,"Q:\n"); for(unsigned i=0;i<CICBUFSIZ/2;i++) fprintf(file,"%d ",_fsk_dq[i+1]>>8); fprintf(file,"\n");
		fprintf(file,"CP:\n"); for(unsigned i=0;i<CICBUFSIZ/2;i++) fprintf(file,"%d ",_fsk_cp[i]); fprintf(file,"\n");*/


	}
	//ufat_log_close();


}


signed short tmpdata[CICBUFSIZ];
/*
	ADC data is 12-bit unsigned, i.e. 13-bit signed.
	Mean removal may not change to 12-bit depending on data distribution, hence input to CIC is 13-bit
	CIC bit growth in worst case is order-1 bits, i.e. 4 bits for 5th order. This is due to 1st stage alternating 0,
	hence the 1st stage imposes no bit growth.

	Alternative 1.
	1. ADC: 13-bit signed
	2. Mean subtract: 13-bit signed
	3. CIC: 17-bit signed


	adc: 13bit -4096-+4095
	adcms: 13 bit -4096-+4095
	cic5: 17 bit -65536-+65535
	cp: -65536*-65536=2^32->error		input must be 16-bit max

	cic5
	sr1: 16 bit -32768-+32767
	cp: -(-32768*-32768)=-1m -> -32768*-32768=1m,2^30 -> 31bit, but can't represent max positive (unlikely so no problem). 32 ok

Alternative 1: CIC5 result on on 32-bit, shift right by 1 (+8 to remove info bits) and feed to CP.

Alternative 2: shift left by 7, CIC5 result on 16-bit, do 16-bit DMA tranfer !!!!! CAN'T WORK, as input of CIC is 16-bit. Max shift left is 4.
	adcms: 13 bit -4096-+4095
	acdms_sl7: 20 bit -524288 -> + 524287
	cic5: 24 bit: -8m -> +8m
	cic5_16msb: 16 upper bits of 24-bit -32768 -> +32767
	cp: -(-32768*-32768)=-1m -> -32768*-32768=1m,2^30 -> 31bit, but can't represent max positive (unlikely so no problem). 32 ok


	cp: 2^n input (n+1 bit)->2^(2n) output

	sr16
	cic bit integration

*/
void fsk_demod_init()
{
	// Call once

	//dsp_real_to_iq_4x_cic_init_dma(_fsk_downsampling,5,0);
	//dsp_real_to_iq_4x_cic_init_dma(_fsk_downsampling,5);		// Used version
	//dsp_real_to_iq_4x_cic_init_dma(_fsk_downsampling,1);

	dsp_real_to_iq_4x_cic_init_cpu(_fsk_downsampling,5);
}
/******************************************************************************
function: fsk_demod_frame
*******************************************************************************

Demodulates a frame of 16-bit input data.

Parameters:
	data		-	Array of 16-bit samples
	binaryout	-	Array of binary demodulated output
	debug		-	Whether to print debug info (1, or 2 for verbose).

Returns:
	-

Benchmarks

	32-bit CIC with blocking CPU read
		dsp_crossproductsign_stream_sr			2005/s
	16-bit CIC with blocking CPU read
		dsp_crossproductsign_stream_in16		1971/s
		dsp_crossproductsign_stream_in16_simd	2088/s
		dsp_crossproductsign_stream_in16_simd_2	2154/s
		dsp_crossproductsign_stream_in16_simd_3	2156/s

	32-bit CIC with nop CPU read
		dsp_crossproductsign_stream_sr			2552/s
	16-bit CIC with nop CPU read
		dsp_crossproductsign_stream_in16		2642/s
		dsp_crossproductsign_stream_in16_simd	2856/s
		dsp_crossproductsign_stream_in16_simd_2	2980/s
		dsp_crossproductsign_stream_in16_simd_3	2984/s


******************************************************************************/
unsigned fsk_demod_frame(signed short * restrict data,unsigned char *restrict binaryout,unsigned debug)
{
	unsigned t1,t2,t3,t4,t5;
	unsigned tt1,tt2,tt3;
	// Call after every new data frame
	// Data frame is assumed to be CICBUFSIZ in length

	// === Calculate mean ===
	if(debug) t1 = timer_us_get();
	signed mean = dsp_mean_simd_12u_16u(data,CICBUFSIZ);
	if(debug) t2 = timer_us_get();


	// Print
	//print_array_short(data,CICBUFSIZ);

	// === Convert to IQ with CIC low-pass filtering and downsampling ===
	//dsp_real_to_iq_4x_cic_process_dma(data,_fsk_di+1,_fsk_dq+1,CICBUFSIZ,mean);		// +1 to keep IQ sample of previous frame.

#if DSP_FSK_USE_CIC_16BIT==1
	dsp_real_to_iq_4x_cic_process_cpu_msb(data,_fsk_dis+1,_fsk_dqs+1,CICBUFSIZ,mean);		// 16-bit result instead of 32.
#else
	dsp_real_to_iq_4x_cic_process_cpu(data,_fsk_di+1,_fsk_dq+1,CICBUFSIZ,mean);		// +1 to keep IQ sample of previous frame.
#endif

	if(debug) t3 = timer_us_get();

	/*if(debug)
	{
		tt1 = timer_us_get();
		dsp_real_to_iq_4x_split(data,_fsk_tmp_di,_fsk_tmp_dq,CICBUFSIZ,mean);		// Trial to split adc into IQ lane to postpone CIC filtering by feeding with DMA
		tt2 = timer_us_get();

	}*/



	// === Direction of rotation through cross-product ===
	if(debug==2) tt1 = timer_us_get();
#if DSP_FSK_USE_CIC_16BIT==1
	//dsp_crossproductsign_stream_in16(_fsk_dis,_fsk_dqs,binaryout,CICBUFSIZ/2,12);
	//dsp_crossproductsign_stream_in16_simd(_fsk_dis,_fsk_dqs,binaryout,CICBUFSIZ/2,12);
	//dsp_crossproductsign_stream_in16_simd_2(_fsk_dis,_fsk_dqs,binaryout,CICBUFSIZ/2,12);
	dsp_crossproductsign_stream_in16_simd_3(_fsk_dis,_fsk_dqs,binaryout,CICBUFSIZ/2,12);
#else
	//dsp_crossproduct_stream_sr(_fsk_di,_fsk_dq,_fsk_cp,CICBUFSIZ/2,12);
	dsp_crossproductsign_stream_sr(_fsk_di,_fsk_dq,binaryout,CICBUFSIZ/2,12);			// Calculate sign of crossproduct and store directly in bit vector
#endif

	//dsp_crossproduct_stream_h16(_fsk_di,_fsk_dq,_fsk_cp2,CICBUFSIZ/2);
	//dsp_crossproduct_stream_h16_simd(_fsk_di,_fsk_dq,_fsk_cp3,CICBUFSIZ/2);
	if(debug==2) tt2 = timer_us_get();
	if(debug==2) fprintf(file_pri,"cp: %u us\n",tt2-tt1);
#if 0
	{
		tt1 = timer_us_get();
		//dsp_crossproduct_stream_sr2(_fsk_di,_fsk_dq,_fsk_cp2,CICBUFSIZ/2,12);
		//dsp_crossproduct_stream_h16_simd(_fsk_di,_fsk_dq,_fsk_cp3,CICBUFSIZ/2);
		for(unsigned i=0;i<100;i++)
		dsp_crossproductsign_stream_in16_simd_3(_fsk_dis,_fsk_dqs,_fsk_binary2,CICBUFSIZ/2,12);
		//dsp_crossproduct_stream_h16(_fsk_di,_fsk_dq,_fsk_cp2,CICBUFSIZ/2);
		//dsp_crossproduct_stream_h16_2(_fsk_di,_fsk_dq,_fsk_cp2,CICBUFSIZ/2);
		tt2 = timer_us_get();
		for(unsigned i=0;i<100;i++)
		dsp_crossproductsign_stream_in16_simd_2(_fsk_dis,_fsk_dqs,_fsk_binary3,CICBUFSIZ/2,12);
		//dsp_crossproduct_stream_sr2(_fsk_di,_fsk_dq,_fsk_cp2,CICBUFSIZ/2,12);
		//dsp_crossproduct_stream_h16(_fsk_di,_fsk_dq,_fsk_cp3,CICBUFSIZ/2);
		//dsp_crossproduct_stream_h16(_fsk_di,_fsk_dq,_fsk_cp2,CICBUFSIZ/2);
		tt3 = timer_us_get();
		for(unsigned s=0;s<4;s++)
		{
			for(unsigned i=s*128;i<s*128+128;i++)
				fprintf(file_pri,"%d",binaryout[i]);
			fprintf(file_pri,"\n");
			for(unsigned i=s*128;i<s*128+128;i++)
				fprintf(file_pri,"%d",_fsk_binary2[i]);
			fprintf(file_pri,"\n");
			for(unsigned i=s*128;i<s*128+128;i++)
				fprintf(file_pri,"%d",_fsk_binary3[i]);
			fprintf(file_pri,"\n");
			fprintf(file_pri,"\n");
		}

		// compare
		unsigned eq=1;
		for(unsigned i=0;i<CICBUFSIZ/2;i++)
		{
			//if(_fsk_cp[i]!=_fsk_cp2[i])
			//if(_fsk_cp2[i]!=_fsk_cp3[i])
			if( (binaryout[i]!=_fsk_binary2[i]) || (_fsk_binary2[i]!=_fsk_binary3[i]) )
			{
				//fprintf(file_pri,"Mismatch at %d: %d %d %d\n",i,binaryout[i],_fsk_binary2[i],_fsk_binary3[i]);
				eq=0;
				break;
			}
		}
		fprintf(file_pri,"cp, cp2 equal: %d\n",eq);
		if(debug==2)
		{
			fprintf(file_pri,"cp2: %u us\n",tt2-tt1);
			fprintf(file_pri,"cp3: %u us\n",tt3-tt2);
		}
	}
#endif

	if(debug) t4 = timer_us_get();

	// === Prepare for next frame streaming processing ===
	// The last I and Q sample is copied at the "past" IQ location to ensure streaming of crossproduct
#if DSP_FSK_USE_CIC_16BIT==1
	_fsk_dis[0] = _fsk_dis[CICBUFSIZ/2];		// Last sample of "current" frame copied to last sample of "previous" frame
	_fsk_dqs[0] = _fsk_dqs[CICBUFSIZ/2];		// Last sample of "current" frame copied to last sample of "previous" frame
#else
	_fsk_di[0] = _fsk_di[CICBUFSIZ/2];		// Last sample of "current" frame copied to last sample of "previous" frame
	_fsk_dq[0] = _fsk_dq[CICBUFSIZ/2];		// Last sample of "current" frame copied to last sample of "previous" frame
#endif


	if(debug) t5 = timer_us_get();


	unsigned t=0;
	if(debug)
	{
		t += t2-t1;
		t += t3-t2;
		t += t4-t3;
		t += t5-t4;

		if(debug==2) fprintf(file_pri,"Mean: %d\n",mean);
		if(debug==2) fprintf(file_pri,"%u %u %u %u\n",t2-t1,t3-t2,t4-t3,t5-t4);
		//if(debug==2) fprintf(file_pri,"split %u\n",tt2-tt1);
	}
	return t;
}


void fsk_demod_bench(signed short * restrict data,int len)
{
	unsigned t1,t2;
	if(len!=CICBUFSIZ)
	{
		fprintf(file_pri,"Invalid length\n");
		return;
	}



	fsk_demod_init();

	unsigned t_last=timer_s_wait(),t_cur;
	unsigned tint1=timer_ms_get_intclk();
	unsigned nsample=0;
	unsigned mintime=1;
	while((t_cur=timer_s_get())-t_last<mintime)
	{
		fsk_demod_frame(data,_fsk_binary,0);
		nsample++;
		//break;	// do once only
	}
	unsigned tint2=timer_ms_get_intclk();
	fprintf(file_pri,"Time: %ds (%lu intclk ms) Frames: %lu. Frames/sec: %lu\n",t_cur-t_last,tint2-tint1,nsample,nsample/(t_cur-t_last));



}
/*
 Generate a test signal alternating f0, f1 at br intervals.
 Phase continuous
*/
void fsk_gentestsignal(signed short *target,int len,int sr,int f0,int f1,int br)
{
	float dt = 1.0/sr;
	float pi = 3.14159265358979323846;
	float bt = 1.0/br; 	// Bit duration
	// y = cos( w * dt * i ) with dt time in-between samples, i index of sample. I.e. phase increment is equal to w*dt

	float w[2] = {2*pi*f0, 2*pi*f1};		// Possible phase increments
	float ph=0;	// Current phase
	for(unsigned i=0;i<len;i++)
	{
		target[i] = (short)(cos(ph)*1023.0+1024.0);

		int b = (dt*i)/bt;	// Current bit
		b=b%2;				// Bit 0 or 1
		ph+=w[b]*dt;		// Increment phase according to
	}



}


/*
 Generate a test signal with a well defined shape.
 Generate rising amplitude from fc-bfs/2 to fc+bfs/2
 Generate rising but lower amplitude from fc+bfs/2 to fc+bff/2; and from -fc-bff/2 to -fc-bfs/2
*/
void fsk_gentestsignal2(signed short *target,int len,int sr,int fc,float bfs, float bff)
{
	float dt = 1.0/sr;
	float pi = 3.14159265358979323846;
	// y = cos( w * dt * i ) with dt time in-between samples, i index of sample. I.e. phase increment is equal to w*dt

	float ampmul = 16.0;		// Ensure a "unit" cosine is has ampmul peak amplitude.

	int nl = 50;		// Number of cosines to generate.
	// Add signal to bandpass
	// Left half
	float fi=0;
	fprintf(file_pri,"Adding to bandpass: lower\n");
	for(float f = fc-bfs/2; f<fc; f+=bfs/nl)
	//float f = fc;
	{
		float amp = 1.5+3.0*fi;
		dsp_addcoswave(target,len,sr,f,amp*ampmul,0);
		//tmp_s=tmp_s*(1.5+3*fi);
		fi=fi+1.0/nl;
	}
	// Right half
	fprintf(file_pri,"Adding to bandpass: upper\n");
	for(float f=fc; f<fc+bfs/2; f+=bfs/nl)
	{
		float amp = 1.5+3.0*fi;
		dsp_addcoswave(target,len,sr,f,amp*ampmul,0);
		//tmp_s=tmp_s*(1.5+3*fi);
		fi=fi+1/nl;
	}
	// Add to filter bandpass
	// Upper
	nl=50;
	fi=0;
	float sc=1.25;
	//fr1=[fc+bfs/2:(bff-bfs)/2/nl:fc+bff/2];
	//fr2=[fc+bff/2:-(bff-bfs)/2/nl:fc+bfs/2];
	fprintf(file_pri,"Adding to noise bandpass: upper\n");
	for(float f = fc+bfs/2; f<fc+bff/2; f+=(bff-bfs)/2.0/nl)
	{
		float amp = 1.0/sc/nl*fi;
		dsp_addcoswave(target,len,sr,f,amp*ampmul,0);
		//tmp_s = tmp_s./sc./nl.*fi;
		fi=fi+1;
	}
	// Lower
	fi=0;
	//fr1 = [fc-bfs/2:-(bff-bfs)/2/nl:fc-bff/2];
	//fr2 = [fc-bff/2:(bff-bfs)/2/nl:fc-bfs/2];
	fprintf(file_pri,"Adding to noise bandpass: lower\n");
	for(float f = fc-bfs/2; f>fc-bff/2; f+= -(bff-bfs)/2.0/nl)
	{
		float amp = 1.0/sc/nl*fi;
		dsp_addcoswave(target,len,sr,f,amp*ampmul,0);
		//tmp_s = tmp_s./sc./nl.*fi;
		fi=fi+1;
	}
}
// Hard-coded test signal of fsk_gentestsignal2
void fsk_gentestsignal2b(signed short *target)
{
	for(int i=0;i<FSKTESTSIGNALLEN;i++)
		target[i] = testsignal_recognizablespectrum[i];
}
void fsk_gentestsignal3(signed short *target)
{
	for(int i=0;i<FSKTESTSIGNALLEN;i++)
		target[i] = testsignal_realundersampled_0[i];
}





/******************************************************************************
	function: fsk_demodout_to_decodein
*******************************************************************************
	Convert the crossproduct output to a binary stream for decoding.

******************************************************************************/
#if 0
void fsk_demodout_to_decodein()
{
	for(unsigned i=0;i<CICBUFSIZ/2;i++)
	{
		_fsk_binary[i] = (_fsk_cp[i]>0)?1:0;
	}
}
#endif




/*
 Real data demodulation + deocding functional test
*/
void dsp_fsk_demod_decode_test_1()
{

	int sr = 1198080;
	int fc = 299520;
	int br=115200;
	int f0 = fc-br/2;
	int f1 = fc+br/2;


	signed short data[FSKTESTSIGNALLEN];			// Same length as matlab
	unsigned datalen=sizeof(data)/sizeof(unsigned short);

	fprintf(file_pri,"Alignment data: %p (%d)\n",data,((unsigned)data)&3);
	fprintf(file_pri,"Alignment _fsk_di: %p (%d)\n",_fsk_di,((unsigned)_fsk_di)&3);
	fprintf(file_pri,"Alignment _fsk_dq: %p (%d)\n",_fsk_dq,((unsigned)_fsk_dq)&3);
	fprintf(file_pri,"Alignment _fsk_dis: %p (%d)\n",_fsk_dis,((unsigned)_fsk_dis)&3);
	fprintf(file_pri,"Alignment _fsk_dqs: %p (%d)\n",_fsk_dqs,((unsigned)_fsk_dqs)&3);
	fprintf(file_pri,"Alignment _fsk_binary: %p (%d)\n",_fsk_binary,((unsigned)_fsk_binary)&3);



	fprintf(file_pri,"Test data lenghth: %d\n",datalen);

	// Real recorded signal
	fsk_gentestsignal3(data);
	fprintf(file_pri,"Data: "); print_array_short(file_pri,data,datalen);

	// Step-by-step demodulation.
	// Number of frames
	int nf = FSKTESTSIGNALLEN/CICBUFSIZ;

	/*unsigned log=0;
	FILE *file = ufat_log_open(log);
	if(!file)
	{
		fprintf(file_pri,"Error opening log %d\n",log);
		return 1;
	}*/

	fsk_demod_init();									// Initialise demodulation
	FILE *ffsk = comm_softuart_open(sr/2,br);			// sr/2 as demod downsamples


	for(int fi=0;fi<nf;fi++)
	//for(int fi=0;fi<1;fi++)
	{
		fprintf(file_pri,"Processing frame %d out of %d\n",fi,nf);
		//fprintf(file_pri,"Data: "); print_array_short(file_pri,&data[fi*CICBUFSIZ],CICBUFSIZ);
		// Initialise the internal buffers for easy debugging
		/*for(unsigned i=0;i<CICBUFSIZ/2;i++)
		{
			_fsk_di[i+1]=_fsk_dq[i+1]=0xfffff;		// +1 as di,dq has +1 size
			_fsk_cp[i]=0xfffff;
		}*/
		//CICBUFSIZ

		// Demodulate: input is data, output is in the crossproduct buffer
		unsigned long t1 = timer_us_get();
		//fsk_demod_frame(&data[fi*CICBUFSIZ],_fsk_binary,2);		// Use all the input signal
		fsk_demod_frame(data,_fsk_binary,2);		// Use only first frame of signal
		// Binarise cp and move to binary signal buffer
		unsigned long t2 = timer_us_get();
		//fsk_demodout_to_decodein();
		// Decode binary signal buffer
		unsigned long t3 = timer_us_get();
		unsigned nd = comm_softuart_decode_frame(_fsk_binary,CICBUFSIZ/2);
		unsigned long t4 = timer_us_get();

		fprintf(file_pri,"Decoded %d bytes. Demodulate: %u us. Copy: %u us. Decode: %u us\n",nd,t2-t1,t3-t2,t4-t3);

		// Print received bytes
		int c; fprintf(file_pri,"Data:\n"); while((c=fgetc(ffsk))!=-1) fprintf(file_pri,"%02X ",c); fprintf(file_pri,"\n");


		/*fprintf(file_pri,"I:\n"); for(unsigned i=0;i<CICBUFSIZ/2;i++) fprintf(file_pri,"%d ",_fsk_di[i+1]>>8); fprintf(file_pri,"\n");
		fprintf(file_pri,"Q:\n"); for(unsigned i=0;i<CICBUFSIZ/2;i++) fprintf(file_pri,"%d ",_fsk_dq[i+1]>>8); fprintf(file_pri,"\n");
		fprintf(file_pri,"CP:\n"); for(unsigned i=0;i<CICBUFSIZ/2;i++) fprintf(file_pri,"%d ",_fsk_cp[i]); fprintf(file_pri,"\n");*/

		/*fprintf(file,"I:\n"); for(unsigned i=0;i<CICBUFSIZ/2;i++) fprintf(file,"%d ",_fsk_di[i+1]>>8); fprintf(file,"\n");
		fprintf(file,"Q:\n"); for(unsigned i=0;i<CICBUFSIZ/2;i++) fprintf(file,"%d ",_fsk_dq[i+1]>>8); fprintf(file,"\n");
		fprintf(file,"CP:\n"); for(unsigned i=0;i<CICBUFSIZ/2;i++) fprintf(file,"%d ",_fsk_cp[i]); fprintf(file,"\n");*/


	}
	//ufat_log_close();

	// Print decoded bytes


}
/*
 Real data demodulation + deocding benchmark
*/
void dsp_fsk_demod_decode_test_2()
{

	int sr = 1198080;
	int fc = 299520;
	int br=115200;
	int f0 = fc-br/2;
	int f1 = fc+br/2;


	signed short data[FSKTESTSIGNALLEN];			// Same length as matlab
	unsigned datalen=sizeof(data)/sizeof(unsigned short);


	fprintf(file_pri,"Test data lenghth: %d\n",datalen);

	// Real recorded signal
	fsk_gentestsignal3(data);
	//fprintf(file_pri,"Data: "); print_array_short(file_pri,data,datalen);

	// Step-by-step demodulation.
	// Number of frames
	int nf = FSKTESTSIGNALLEN/CICBUFSIZ;

	/*unsigned log=0;
	FILE *file = ufat_log_open(log);
	if(!file)
	{
		fprintf(file_pri,"Error opening log %d\n",log);
		return 1;
	}*/

	fsk_demod_init();									// Initialise demodulation
	FILE *ffsk = comm_softuart_open(sr/2,br);			// sr/2 as demod downsamples


	unsigned t_last=timer_s_wait(),t_cur;
	unsigned tint1=timer_ms_get_intclk();
	unsigned nsample=0;
	unsigned mintime=1;
	unsigned nd=0;
	unsigned tdemod=0;
	while((t_cur=timer_s_get())-t_last<mintime)
	{
		// Demodulate always same frame
		tdemod+=fsk_demod_frame(data,_fsk_binary,0);
		// Binarise cp and move to binary signal buffer
		//fsk_demodout_to_decodein();		// Already done by demod_frame
		// Decode binary signal buffer
		nd += comm_softuart_decode_frame(_fsk_binary,CICBUFSIZ/2);
		// Empty data
		while(fgetc(ffsk)!=-1);

		nsample++;
		//break;	// do once only
	}
	unsigned tint2=timer_ms_get_intclk();
	fprintf(file_pri,"Time: %ds (%lu intclk ms) Frames: %lu. Frames/sec: %lu\n",t_cur-t_last,tint2-tint1,nsample,nsample/(t_cur-t_last));
	fprintf(file_pri,"Decoded total of %u bytes in %u frames\n",nd,nsample);
	fprintf(file_pri,"Demod time: %u\n",tdemod);


}

void dsp_fsk_adc_demod_decode_help()
{
	fprintf(file_pri,"Commands:\n");
	fprintf(file_pri,"\t?   : help\n");
	fprintf(file_pri,"\tQ, q: quit\n");
	fprintf(file_pri,"\tR, r: display RX data\n");
	fprintf(file_pri,"\tH, h: toggle hex/ascii RX display\n");
	fprintf(file_pri,"\tA, a: display ADC and demodulated data\n");
	fprintf(file_pri,"\tS, s: display ADC statistics\n");
	fprintf(file_pri,"\tI, i: display processing information at regular intervals\n");
	fprintf(file_pri,"\tW, w: display waveform\n");
	fprintf(file_pri,"\tO, o: overlay waveform display\n");
	fprintf(file_pri,"\tK, k: generate reference 200Hz tone with sr=8KHz\n");
	fprintf(file_pri,"\tP, p: play received data an 8-bit audio stream (default sr=8KHz)\n");
	fprintf(file_pri,"\t8: set sr=8KHz\n");
	fprintf(file_pri,"\t0: set sr=10KHz\n");
	fprintf(file_pri,"\tK, k: generate reference 200Hz tone with sr=8KHz\n");
	fprintf(file_pri,"\t*, /: increase/decrease sample rate. Needs to stop/start audio to take effect\n");
	fprintf(file_pri,"\tx: Enable checksum check using bit 0\n");
}
void dsp_fsk_adc_demod_decode_printstat(signed short *adcdata,unsigned len)
{
	int mean = dsp_mean(adcdata,len);
	int std = dsp_std(adcdata,len,mean);
	int mn = dsp_min(adcdata,len);
	int mx = dsp_max(adcdata,len);
	fprintf(file_pri,"Mean: %d. Standard deviation: %d. Min: %d. Max: %d\n",mean,std,mn,mx);
	// Calculate a histogram. ADC data is in range 0-4095. Assume bins of 64, i.e. 64*64=4096.
	unsigned long hist[64];
	hist_init(hist,64);
	for(int i=0;i<len;i++)
	{
		hist_insert(hist,64,64,adcdata[i]);
	}
	// Print histogram
	hist_print(file_pri,hist,64,64);
}
unsigned ckparity(unsigned char b)
{
	// Parity should be even, i.e. even number of ones.
	unsigned char p=0;
	// popcount
	for(unsigned i=0;i<8;i++)
	{
		p+=b&1;
		b>>=1;
	}
	// Return 0 if parity is even (i.e. correct parity).
	return p&1;
}

unsigned dsp_fsk_adc_demod_decode_loop_audioplayback_enabled=0;
unsigned dispadc=0;
unsigned dispinfo=0;
unsigned disprx=0;
unsigned disphex=0;
unsigned dispstat=0;
unsigned dispwave=0;
unsigned dispoverlay=0;
unsigned opt_cksum=0;
void dsp_fsk_adc_demod_decode_loop_audioplayback(unsigned short * restrict buffer,unsigned int n)
{
	char data[DACDMAHALFBUFSIZ];		// n is equal to DACDMAHALFBUFSIZ.



	if(dsp_fsk_adc_demod_decode_loop_audioplayback_enabled==0)
	{
		for(unsigned i=0;i<n;i++)
			buffer[i]=0;
		return;
	}

#if 0
	for(unsigned i=0;i<n;i++)
	{
		buffer[i] = 0;
		for(int w=0;w<_stm_dac_cosinegenerator_numwaveforms;w++)
		{
			unsigned int s = _stm_dac_cos_lut[_stm_dac_lut_index[w]>>16];		// Index is in 16.16 format
			s=(s*_stm_dac_waveform_vol[w])>>12;									// Volume is 0..4096 inclusive
			buffer[i] += s;
			_stm_dac_lut_index[w] += _stm_dac_lut_incr[w];
			_stm_dac_lut_index[w] &= STMDAC_LUTINDEXMASK;						// Wraparound
		}
		//_stm_dac_dmabuf[DACDMAHALFBUFSIZ+i] /= _stm_dac_numwaveforms;			// Rescale to ensure same amplitude regardless of number of waveforms
		//_stm_dac_dmabuf[DACDMAHALFBUFSIZ+i] /= _stm_dac_ampldiv;
	}
	return;
#endif

	// Playback is enabled: should read data

	//unsigned rd = fread(data,1,DACDMAHALFBUFSIZ,_serial_uasrt3_file);	// Can't use fread in interrupt as blocking
	unsigned tt1,tt2,tt3;
	tt1=timer_us_get();
	unsigned rd=0;

	if(comm_softuart_level()<DACDMAHALFBUFSIZ)
	{
		fprintf(file_pri,"Not enough - skip frame\n");
		for(unsigned i=0;i<n;i++)
		{
			buffer[i]=0;
		}
		return;
	}
	rd = comm_softuart_get(data,DACDMAHALFBUFSIZ);

	if(rd!=DACDMAHALFBUFSIZ)
	{
		fprintf(file_pri,"Not enough data! n: %d rd: %d\n",n,rd);

	}
	// Calculate checksum
	if(opt_cksum)
	{
		for(unsigned i=0;i<n;i++)
		{
			if(ckparity(data[i]))
				fprintf(file_pri,"Parity error at %u: %02X\n",i,data[i]);
		}
	}

	// Generate triangle
	for(unsigned i=0;i<n;i++)
	{
		//buffer[i] = i;
		buffer[i] = data[i];
	}
	tt2=timer_us_get();
	fprintf(file_pri,"Dac: %u\n",tt2-tt1);
	//tt3=timer_us_get();
	//fprintf(file_pri,"DAC cb: %u bytes. %u %u\n",rd, tt2-tt1,tt3-tt2);
}
dsp_fsk_adc_demod_decode_loop_play_triangle(unsigned short * restrict buffer,unsigned int n)
{
	for(unsigned i=0;i<n;i++)
	{	// Triangle wave
		buffer[i] = (i&31)*8;
	}
}
/******************************************************************************
	function: dsp_fsk_adc_demod_decode_loop
*******************************************************************************
	Continuously acquire ADC data, demodulate, decode and print.

	Input:
		sr:		ADC sample rate
		br:		Data bitrate

******************************************************************************/
void dsp_fsk_adc_demod_decode_loop(unsigned sr,unsigned br,unsigned autoplay)
{
	signed short adcdata[ADCFAST_BUFFERSIZE];
	char rxbytes[ADCFAST_BUFFERSIZE];

	//br/=10;
	//br/=5;
	//br*=2;
	//br = 192000;
	//br=115000;

	fprintf(file_pri,"Continuous decoding until key press\n");
	fprintf(file_pri,"Desired sample rate: %d. Bit rate: %u\n",sr,br);

	dsp_fsk_adc_demod_decode_help();


	// Initialise the ADC
	unsigned prescaler=0;
	//unsigned channels = 0b10000;
	unsigned channels = 0b00001;	// Channel 1
	// Calculate divider
	unsigned divider = stm_adcfast_samplerate_to_divider(sr,prescaler);

	// Stop any previous acquisition
	stm_adcfast_acquire_stop();

	// Initialise demodulation
	fsk_demod_init();
	// Initialise decoding. sr/2 as demod downsamples
	FILE *ffsk = comm_softuart_open(sr/2,br);
	//FILE *ffsk = comm_softuart_open(1198080/2,br);




	int c;
	unsigned tdm0=0,tdm1=0,tdm2=0,tdm3=0;
	unsigned adc_effsize;
	unsigned long adc_timems,adc_pktctr;
	unsigned nsample=0;
	unsigned stat_nsample=0;
	unsigned stat_decoded=0,tot_decoded=0;
	unsigned nd=0;
	unsigned tdemod=0;
	unsigned statevery=2;
	unsigned t_laststat,t_last,t_cur;
	FILE *file_fsk=0;

	t_laststat=t_last=timer_s_wait();		// Wait to start on integer second
	unsigned tint1=timer_ms_get_intclk();

	// Initialise DAC
	stmdac_init(8000,0); stmdac_deinit();	// Initialise and deinitalise to set the sample rate.
	stm_dac_cosinegenerator_init();
	stm_dac_cosinegenerator_addwaveform(200,256);
	unsigned audio_sr = 8000;

	// Acquire ADC
	stm_adcfast_acquire_start(channels,0,0,0,prescaler,divider);
	int kbd;
	while(1)		// Loop until keypress
	{
		kbd = fgetc(file_pri);
		if(kbd=='R' || kbd=='r')
			disprx=1-disprx;
		if(kbd=='A' || kbd=='a')
			dispadc=1-dispadc;
		if(kbd=='H' || kbd=='h')
			disphex=1-disphex;
		if(kbd=='Q' || kbd=='q')
			break;
		if(kbd=='S' || kbd=='s')
			dispstat=1-dispstat;
		if(kbd=='I' || kbd=='i')
			dispinfo=1-dispinfo;
		if(kbd=='W' || kbd=='w')
			dispwave=1-dispwave;
		if(kbd=='O' || kbd=='o')
			dispoverlay=1-dispoverlay;
		if(kbd=='x')
		{
			opt_cksum=1-opt_cksum;
			fprintf(file_pri,"Parity check: %d\n",opt_cksum);
		}

		if(kbd=='*')
		{
			audio_sr+=100;
			fprintf(file_pri,"New sample rate: %d\n",audio_sr);
		}
		if(kbd=='/')
		{
			audio_sr-=100;
			fprintf(file_pri,"New sample rate: %d\n",audio_sr);
		}
		if(kbd=='8')
		{
			audio_sr=8000;
			fprintf(file_pri,"New sample rate: %d\n",audio_sr);
		}
		if(kbd=='0')
		{
			audio_sr=10000;
			fprintf(file_pri,"New sample rate: %d\n",audio_sr);
		}
		if(kbd=='P' || kbd=='p' || autoplay)
		{
			autoplay=0;
			dsp_fsk_adc_demod_decode_loop_audioplayback_enabled=1-dsp_fsk_adc_demod_decode_loop_audioplayback_enabled;
			if(dsp_fsk_adc_demod_decode_loop_audioplayback_enabled)
				//stmdac_init(8000,stm_dac_cosinegenerator_siggen);
				stmdac_init(audio_sr,dsp_fsk_adc_demod_decode_loop_audioplayback);
			else
				stmdac_deinit();
		}
		if(kbd=='K' || kbd=='k')
		{
			dsp_fsk_adc_demod_decode_loop_audioplayback_enabled=1-dsp_fsk_adc_demod_decode_loop_audioplayback_enabled;
			if(dsp_fsk_adc_demod_decode_loop_audioplayback_enabled)
				//stmdac_init(8000,stm_dac_cosinegenerator_siggen);
				stmdac_init(8000,dsp_fsk_adc_demod_decode_loop_play_triangle);
			else
				stmdac_deinit();
		}
		if(kbd=='?')
			dsp_fsk_adc_demod_decode_help();
		if(kbd=='F' || kbd=='f')
		{
			//file_fsk = serial_usart3_init(br,2);
			file_fsk = serial_usart3_init(br,LL_USART_STOPBITS_2);
			fprintf(file_pri,"Opened file: %p\n",file_fsk);
		}
		if(kbd=='t')
		{
			if(file_fsk)
				fprintf(file_fsk,"TEST\n");
		}
		if(kbd=='T')
		{
			if(file_fsk)
			{
				char d[4096];
				for(int i=0;i<4096;i++)
					d[i]='0'+i%10;
				for(int i=4090;i<4096;i++)
					d[i]=0xff;
				fwrite(d,1,4096,file_fsk);
				fflush(file_fsk);
			}
		}

		// === Get the ADC data ===
		tdm0 = timer_us_get();
		if(stm_adcfast_data_getnext(adcdata,&adc_effsize,&adc_timems,&adc_pktctr))
			continue;	// Skip rest of processing if no data

		// Update statistics
		nsample++;
		stat_nsample++;

		// === Demodulate the data ===
		tdm1 = timer_us_get();
		fsk_demod_frame(adcdata,_fsk_binary,0);
		//fsk_demod_frame(testsignal_realundersampled_0,_fsk_binary,0);
		tdm2 = timer_us_get();

		// === Decode data to binary signal buffer ===
		nd = comm_softuart_decode_frame(_fsk_binary,ADCFAST_BUFFERSIZE/2);
		tdm3 = timer_us_get();

		tot_decoded += nd;		// Number of decoded bytes total.
		stat_decoded += nd;		// Number of decoded bytes for stats.

		// Clear the adcdata for debugging
		//for(unsigned i=0;i<ADCFAST_BUFFERSIZE;i++) adcdata[i]=0;
		// Set adcdata to known value for debugging
		//for(unsigned i=0;i<ADCFAST_BUFFERSIZE;i++) adcdata[i]=testsignal_realundersampled_0[i];


		// === Read the decoded data ===
		// Data read only when audio playback is disabled. Audio playback reads directly from incoming buffer in DAC interrupt for speed.
		if(dsp_fsk_adc_demod_decode_loop_audioplayback_enabled==0)
		{
			unsigned rbi=0;
			// Get the data
			while((c=fgetc(ffsk))!=-1)
			{
				rxbytes[rbi++] = c;

			}
			if(opt_cksum)
			{
				// Always check the received checksum, even if not displayig received data
				for(unsigned i=0;i<rbi;i++)
				{
					if(ckparity(rxbytes[i]))
					{
						fprintf(file_pri,"Parity error at %u: %02x\n",i,rxbytes[i]);
					}
				}
			}

			//fprintf(file_pri,"Decoded: %d\n",nd);
			if(disprx && rbi)
			{

				fprintf(file_pri,"RX: ");

				for(unsigned i=0;i<rbi;i++)
				{
					if(disphex)
					{
						fprintf(file_pri,"%02X ",rxbytes[i]);
					}
					else
					{
						if(rxbytes[i]>=32 && rxbytes[i]<=126)
							fprintf(file_pri," %c ",rxbytes[i]);
						else
							fprintf(file_pri,"%02X ",rxbytes[i]);
					}
				}
				fprintf(file_pri,"\n");
			}
		}

		// === Information ===
		t_cur = timer_s_get();
		// Stat severy statevery milliseconds.
		if(dispinfo && (t_cur-t_laststat>=statevery) )
		{
			fprintf(file_pri,"\n=== Information ===\n");
			fprintf(file_pri,"Elapsed time from start: %u. Total ADC frames: %u. Total bytes decoded: %u\n",t_cur-t_last,nsample,tot_decoded);
			fprintf(file_pri,"ADC buffer level: %u. ADC frames lost: %u\n",stm_adcfast_data_level(),stm_adcfast_stat_lostframes());
			fprintf(file_pri,"Instantaneous ADC frames/s: %u. Sample rate: %u\n",stat_nsample/(t_cur-t_laststat),stat_nsample*ADCFAST_BUFFERSIZE/(t_cur-t_laststat));
			fprintf(file_pri,"Instantaneous RX bytes: %u. Bytes/s: %u\n",stat_decoded,stat_decoded/(t_cur-t_laststat));
			fprintf(file_pri,"Last frame: acquire time: %u us, demodulation time: %u us, decoding time: %u us\n",tdm1-tdm0,tdm2-tdm1,tdm3-tdm2);
			fprintf(file_pri,"UART RX level: %u\n",comm_softuart_level());
			comm_softuart_printstat();
			fprintf(file_pri,"\n");



			// Reset stats for next round
			t_laststat=t_cur;
			stat_nsample=0;
			stat_decoded=0;
		}

		// Calculate statistics / histogram
		if(dispstat && (nsample&1023)==0)
		{
			dsp_fsk_adc_demod_decode_printstat(adcdata,ADCFAST_BUFFERSIZE);
		}


		// Every lots of frames 1024 frame print it
		if(dispadc && (nsample&1023)==0)
		{
			fprintf(file_pri,"ADC:\n");
			print_array_short(file_pri,adcdata,ADCFAST_BUFFERSIZE);
		}

		//continue;

		if(dispadc && (nsample&1023)==0)
		{
			fprintf(file_pri,"Binary:\n");
			print_array_char(file_pri,_fsk_binary,ADCFAST_BUFFERSIZE/2);
		}
		if(dispwave && (nsample&1023)==0)
		{
			scope_plot(file_pri,adcdata,64,32,4095,dispoverlay);
		}



	}
	t_cur=timer_s_get();
	unsigned tint2=timer_ms_get_intclk();
	fprintf(file_pri,"Time: %ds (%lu intclk ms) Frames: %lu. Frames/sec: %lu\n",t_cur-t_last,tint2-tint1,nsample,nsample*1000/(tint2-tint1));
	fprintf(file_pri,"Decoded total of %u bytes in %u frames\n",tot_decoded,nsample);
	fprintf(file_pri,"Sample rate: %u sps\n",nsample*1000*ADCFAST_BUFFERSIZE/(tint2-tint1)/1000);
	//fprintf(file_pri,"Demod time: %u\n",tdemod);

	// Stop playback
	stmdac_deinit();

	// Stop data acquisition
	stm_adcfast_acquire_stop();


}


